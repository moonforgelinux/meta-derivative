## meta-derivative-distro/conf/distro/derivative.conf
```bitbake
require conf/distro/moonforge.conf

DISTRO = "derivative"
DISTRO_NAME = "Derivative OS (Derivative Linux Distribution)"
DISTRO_VERSION = "5.0"

MAINTAINER = "Someone <someone@derivative.example>"
```

## meta-derivative-distro/conf/layer.conf
```bitbake
# We have a conf and classes directory, add to BBPATH
BBPATH .= ":${LAYERDIR}"

# We have recipes-* directories, add to BBFILES
BBFILES += "${LAYERDIR}/recipes-*/*/*.bb \
            ${LAYERDIR}/recipes-*/*/*.bbappend"

BBFILE_COLLECTIONS += "meta-derivative-distro"
BBFILE_PATTERN_meta-derivative-distro = "^${LAYERDIR}/"
BBFILE_PRIORITY_meta-derivative-distro = "20"

LAYERDEPENDS_meta-derivative-distro = " \
    core \
    meta-moonforge-distro \
"
LAYERSERIES_COMPAT_meta-derivative-distro = "scarthgap"
```
